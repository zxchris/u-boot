## configs/redquarkone_defconfig
```kconfig
CONFIG_IDENT_STRING=" Retro Games - Redquark One"
CONFIG_ARM=y
CONFIG_ARCH_SUNXI=y
CONFIG_MACH_SUN7I=y
CONFIG_DRAM_CLK=384
CONFIG_DEFAULT_DEVICE_TREE="sun7i-a20-redquarkone"
CONFIG_SPL=y
CONFIG_SPL_I2C_SUPPORT=y
# CONFIG_AHCI is not set
# CONFIG_SYS_MALLOC_CLEAR_ON_INIT is not set
# CONFIG_SYS_EXTRA_OPTIONS is not set
# CONFIG_CMD_IMLS is not set
# CONFIG_CMD_FLASH is not set
# CONFIG_CMD_FPGA is not set
# CONFIG_SPL_DOS_PARTITION is not set
# CONFIG_SPL_ISO_PARTITION is not set
# CONFIG_SPL_EFI_PARTITION is not set
# CONFIG_ETH_DESIGNWARE is not set
# CONFIG_DM_ETH is not set
# CONFIG_NETDEVICES is not set
# CONFIG_CMD_DHCP is not set
# CONFIG_CMD_PXE is not set
# CONFIG_CMD_NFS is not set
# CONFIG_CMD_MII is not set
# CONFIG_CMD_PING is not set

CONFIG_CMD_NET=y
CONFIG_NET=y

#CONFIG_LED=y
#CONFIG_LED_GPIO=y

CONFIG_AXP_ALDO3_VOLT=2800
CONFIG_AXP_ALDO4_VOLT=2800
CONFIG_USB_EHCI_HCD=y
```
